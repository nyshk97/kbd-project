## boards/p02-auto-kdk/generated/boards/shields/split_us60pct/Kconfig.defconfig
```kconfig
if SHIELD_SPLIT_US60PCT_RIGHT

config ZMK_KEYBOARD_NAME
    default "split_us60pct"

endif

if SHIELD_SPLIT_US60PCT_LEFT || SHIELD_SPLIT_US60PCT_RIGHT

config ZMK_SPLIT
    default y

endif
```

## boards/p02-auto-kdk/generated/boards/shields/split_us60pct/Kconfig.shield
```kconfig
config SHIELD_SPLIT_US60PCT_LEFT
    def_bool $(shields_list_contains,split_us60pct_left)
config SHIELD_SPLIT_US60PCT_RIGHT
    def_bool $(shields_list_contains,split_us60pct_right)
```
